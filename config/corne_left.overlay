/* config/boards/shields/corne/corne_left.overlay */

#include <dt-bindings/zmk/matrix_transform.h>

/ {
    chosen {
        zmk,kscan = &kscan0;
    };

    kscan0: kscan_0 {
        compatible = "zmk,kscan-gpio-matrix";
        label = "KSCAN";
        diode-direction = "col2row";

        /* Your Custom Reversed Column Pins */
        col-gpios
            = <&pro_micro 14 GPIO_ACTIVE_HIGH>
            , <&pro_micro 15 GPIO_ACTIVE_HIGH>
            , <&pro_micro 18 GPIO_ACTIVE_HIGH>
            , <&pro_micro 19 GPIO_ACTIVE_HIGH>
            , <&pro_micro 20 GPIO_ACTIVE_HIGH>
            , <&pro_micro 21 GPIO_ACTIVE_HIGH>
            ;

        /* Standard Corne Row Pins (Verify these match your soldering!) */
        row-gpios
            = <&pro_micro 4 (GPIO_ACTIVE_HIGH | GPIO_PULL_DOWN)>
            , <&pro_micro 5 (GPIO_ACTIVE_HIGH | GPIO_PULL_DOWN)>
            , <&pro_micro 6 (GPIO_ACTIVE_HIGH | GPIO_PULL_DOWN)>
            , <&pro_micro 7 (GPIO_ACTIVE_HIGH | GPIO_PULL_DOWN)>
            ;
    };
};
